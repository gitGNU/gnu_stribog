/*LPC213x linker script template for RAM-based program
Copyright (C) 2006, 2008\
 Ineiev<ineiev@users.sourceforge.net>, super V 93
This file has been written for the stribog project.

This program is free software; you can redistribute it and/or modify
it under the terms of the GNU General Public License as published by
the Free Software Foundation; either version 3 of the License, or
(at your option) any later version.

This program is distributed in the hope that it will be useful,
but WITHOUT ANY WARRANTY; without even the implied warranty of
MERCHANTABILITY or FITNESS FOR A PARTICULAR PURPOSE.  See the
GNU General Public License for more details.

You should have received a copy of the GNU General Public License
along with this program. If not, see <http://www.gnu.org/licenses/>.*/
OUTPUT_FORMAT("elf32-littlearm")
/*actually the bootloader is thought
to be strictly position-independent when running in RAM*/
MEMORY
{ ram(!r) : o = 0x40000000+32k-1k-512, l = 1k+512 }
/*this constant is used to assign stack pointer from PC*/
_trimmed_loader_size = 1k+512-0x20;
SECTIONS
{.text :
 { *boot.o(.text)
   *init.o(.text)
   *pll.o(.text)
   . =  512;
   *(.text)
   *(.rodata)
   *(.bss)
   *(.data)
   *(.glue_7)
   *(.glue_7t)
 } >ram
}
