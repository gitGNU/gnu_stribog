/*LPC213x linker script template for RAM-based program
Copyright (C) 2006, 2008\
 Ineiev<ineiev@users.sourceforge.net>, super V 93
This file has been written for the stribog project.

This program is free software; you can redistribute it and/or modify
it under the terms of the GNU General Public License as published by
the Free Software Foundation; either version 3 of the License, or
(at your option) any later version.

This program is distributed in the hope that it will be useful,
but WITHOUT ANY WARRANTY; without even the implied warranty of
MERCHANTABILITY or FITNESS FOR A PARTICULAR PURPOSE.  See the
GNU General Public License for more details.

You should have received a copy of the GNU General Public License
along with this program. If not, see <http://www.gnu.org/licenses/>.*/
/*sections fill should be 0x4E4F2043414D454C0A, if any*/
OUTPUT_FORMAT("elf32-littlearm")
/*comment_on_the_cpu*/
MEMORY
{ ram (!r) : o = 0x40000000, l = LENGTH_ram_ }
_arm_stack_bottom = ORIGIN_ram_ + LENGTH_ram_ - 4;
_arm_ram_begin = ORIGIN_ram_;
SECTIONS
{.text :
 { *(.vectors)
   *boot.o(.text)
   *(.text)
   *(.rodata)
/* *(.ctors) *(.dtors) *(.jcr) /*these appear when I suddenly use c++*/
   *(.data)
   *(.glue_7)
   *(.glue_7t)
 } >ram
 . = ALIGN(4);
 .bss :
 { _bss_data_begin = .;
   *(.bss)
   . = ALIGN(4);
   _bss_data_end = .;
 } >ram
 _rom_data_begin = .; _rom_data_end = .;
}
